AUTOSAR XML (schema 4-2-1)
package /Platform
  system System
package /Cluster
  can cluster MY_CLUSTER: baudrate=500000, protocol-name=CAN, protocol-version=2.0
    can physical channel CHNL
      frame FrameA: id 0x1, frame-length=2, can-addressing-mode=STANDARD, can-frame-rx-behavior=CAN-20, can-frame-tx-behavior=CAN-20
        pdu PduA: length=2, unused-bit-pattern=0
          signal SignalA: start 7, 8 bit, little-endian, compu {0=OFF, 1=ON, ..2=INVALID, phys=raw for raw 0..1}, transfer-property=TRIGGERED
