VERSION ""

NS_ :

BS_:

BU_:

BO_ 1 Message1: 1 Vector__XXX
 SG_ Signal1 : 8|1@1+ (1,0) [0|1] "" Vector__XXX
