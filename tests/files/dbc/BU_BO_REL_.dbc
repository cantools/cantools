VERSION ""

NS_ :

BS_:

BU_: COM

BO_ 1 CONTROL: 7 COM
 SG_ state : 0|8@1+ (1,0) [0|100] "%" Vector__XXX

BA_DEF_REL_ BU_BO_REL_  "MsgProject" ENUM  "A","B","C";
BA_DEF_DEF_REL_ "MsgProject" "A";
BA_REL_ "MsgProject" BU_BO_REL_ COM 1 2;

VAL_ 1 state 255 "Invalid" ;
