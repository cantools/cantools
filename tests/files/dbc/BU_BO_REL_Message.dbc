VERSION ""

NS_ :

BS_:

BU_: ECU1 ECU2

BO_ 1 message_1: 7 ECU1
 SG_ signal_1 : 0|8@1+ (1,0) [0|100] ""  ECU2

BA_DEF_REL_ BU_BO_REL_  "MsgProject" ENUM  "A","B","C";
BA_DEF_DEF_REL_ "MsgProject" "A";

BA_REL_ "MsgProject" BU_BO_REL_ ECU1 1 2;
VAL_ 1 signal_1 255 "Invalid" ;
