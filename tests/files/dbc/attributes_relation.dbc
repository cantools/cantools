VERSION ""

NS_ :

BS_:

BU_: ECU2 ECU1

BO_ 2148676694 Message1: 8 ECU1
 SG_ BIT_F m24 : 39|1@1+ (1,0) [0|0] ""  ECU2
 SG_ BIT_H m24 : 38|1@1+ (1,0) [0|0] ""  ECU2
 SG_ BIT_B m24 : 33|1@1+ (1,0) [0|0] ""  ECU2
 SG_ BIT_D m24 : 32|1@1+ (1,0) [0|0] ""  ECU2
 SG_ BIT_E m24 : 29|1@1+ (1,0) [0|0] ""  ECU2
 SG_ BIT_K m24 : 28|1@1+ (1,0) [0|0] ""  ECU2
 SG_ BIT_A m24 : 26|1@1+ (1,0) [0|0] ""  ECU2
 SG_ BIT_L m8 : 24|1@1+ (1,0) [0|0] ""  ECU2
 SG_ BIT_G m8 : 23|1@1+ (1,0) [0|0] ""  ECU2
 SG_ BIT_C m8 : 19|1@1+ (1,0) [0|0] ""  ECU2
 SG_ BIT_J m8 : 18|1@1+ (1,0) [0|0] ""  ECU2
 SG_ Multiplexor M : 2|6@1+ (1,0) [0|0] ""  ECU2

CM_ "SpecialRelease";
CM_ SG_ 2148676694 Multiplexor "Defines data content for response messages.";
BA_DEF_ BO_  "VFrameFormat" ENUM  "StandardCAN","ExtendedCAN","reserved","J1939PG";
BA_DEF_ SG_  "GenSigSendType" ENUM  "Cyclic","OnWrite","OnWriteWithRepetition","OnChange","OnChangeWithRepetition","IfActive","IfActiveWithRepetition","NoSigSendType";
BA_DEF_ BO_  "GenMsgSendType" ENUM  "Cyclic","not_used","not_used","not_used","not_used","Cyclic","not_used","IfActive","NoMsgSendType";
BA_DEF_ BU_  "NmStationAddress" HEX 0 0;
BA_DEF_  "DBName" STRING ;
BA_DEF_  "BusType" STRING ;
BA_DEF_REL_ BU_SG_REL_  "SigTimeoutTime" INT 0 65535;
BA_DEF_DEF_  "VFrameFormat" "J1939PG";
BA_DEF_DEF_  "GenSigSendType" "Cyclic";
BA_DEF_DEF_  "GenMsgSendType" "NoMsgSendType";
BA_DEF_DEF_  "NmStationAddress" 0;
BA_DEF_DEF_  "DBName" "";
BA_DEF_DEF_  "BusType" "CAN";
BA_DEF_DEF_REL_ "SigTimeoutTime" 0;
BA_ "DBName" "Network_A";
BA_ "NmStationAddress" BU_ ECU2 2;
BA_REL_ "SigTimeoutTime" BU_SG_REL_ ECU2 SG_ 2148676694 BIT_F 6000;
BA_REL_ "SigTimeoutTime" BU_SG_REL_ ECU2 SG_ 2148676694 BIT_H 6000;
BA_REL_ "SigTimeoutTime" BU_SG_REL_ ECU2 SG_ 2148676694 BIT_B 6000;
BA_REL_ "SigTimeoutTime" BU_SG_REL_ ECU2 SG_ 2148676694 BIT_D 6000;
BA_REL_ "SigTimeoutTime" BU_SG_REL_ ECU2 SG_ 2148676694 BIT_E 6000;
BA_REL_ "SigTimeoutTime" BU_SG_REL_ ECU2 SG_ 2148676694 BIT_K 6000;
BA_REL_ "SigTimeoutTime" BU_SG_REL_ ECU2 SG_ 2148676694 BIT_A 6000;
BA_REL_ "SigTimeoutTime" BU_SG_REL_ ECU2 SG_ 2148676694 BIT_L 6000;
BA_REL_ "SigTimeoutTime" BU_SG_REL_ ECU2 SG_ 2148676694 BIT_G 6000;
BA_REL_ "SigTimeoutTime" BU_SG_REL_ ECU2 SG_ 2148676694 BIT_C 6000;
BA_REL_ "SigTimeoutTime" BU_SG_REL_ ECU2 SG_ 2148676694 BIT_J 6000;
BA_REL_ "SigTimeoutTime" BU_SG_REL_ ECU2 SG_ 2148676694 Multiplexor 6000;

SG_MUL_VAL_ 2148676694 BIT_L Multiplexor 8-8, 16-16, 24-24;
SG_MUL_VAL_ 2148676694 BIT_G Multiplexor 8-8, 16-16, 24-24;
SG_MUL_VAL_ 2148676694 BIT_C Multiplexor 8-8, 16-16, 24-24;
SG_MUL_VAL_ 2148676694 BIT_J Multiplexor 8-8, 16-16, 24-24;
