VERSION ""

NS_ :

BS_:

BU_:
VAL_TABLE_ CmdResp 1 "CmdRespOK" 0 "CmdRespErr" ;

BO_ 2148073472 TestMessage: 1 Vector__XXX
 SG_ SignalWithChoices : 0|1@1+ (1,0) [0|0] "" Vector__XXX

BA_DEF_  "BusType" STRING ;
BA_DEF_DEF_  "BusType" "CAN";
VAL_ 2148073472 SignalWithChoices 1 "CmdRespOK" 0 "CmdRespErr" ;
