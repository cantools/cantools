VERSION ""

NS_ :

BS_:

BU_:

BO_ 2147483651 TestMsg_Ex: 8 Vector__XXX
 SG_ TestSig_Copy_1 : 0|8@1- (1,0) [0|0] "" Vector__XXX

BO_ 2 TestMsg_Std: 8 Vector__XXX
 SG_ TestSig_Copy_3 : 0|8@1- (1,0) [0|0] "" Vector__XXX

BO_ 1 TestMsg_FDStd: 8 Vector__XXX
 SG_ TestSig_Copy_2 : 0|8@1- (1,0) [0|0] "" Vector__XXX

BO_ 2147483648 TestMsg_FDEx: 8 Vector__XXX
 SG_ TestSig : 0|8@1- (1,0) [0|0] "" Vector__XXX

BA_DEF_ BO_  "CANFD_BRS" ENUM  "0","1";
BA_DEF_  "DBName" STRING ;
BA_DEF_  "BusType" STRING ;
BA_DEF_ BO_  "VFrameFormat" ENUM  "StandardCAN","ExtendedCAN","reserved","reserved","reserved","reserved","reserved","reserved","reserved","reserved","reserved","reserved","reserved","reserved","StandardCAN_FD","ExtendedCAN_FD";
BA_DEF_DEF_  "CANFD_BRS" "1";
BA_DEF_DEF_  "DBName" "";
BA_DEF_DEF_  "BusType" "";
BA_DEF_DEF_  "VFrameFormat" "StandardCAN";
BA_ "BusType" "CAN FD";
BA_ "DBName" "fd_test";
BA_ "VFrameFormat" BO_ 2147483651 1;
BA_ "VFrameFormat" BO_ 1 14;
BA_ "VFrameFormat" BO_ 2147483648 15;
