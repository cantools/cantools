VERSION ""

NS_ :

BS_:

BU_: TestNode

BO_ 1024 Message1: 8 TestNode
 SG_ Signal1 : 0|64@1- (1,0) [0|0] "" Vector__XXX

BO_ 1025 Message2: 8 TestNode
 SG_ Signal2 : 32|32@1- (1,0) [0|0] "" Vector__XXX
 SG_ Signal1 : 0|32@1- (1,0) [0|0] "" Vector__XXX

BO_ 1026 Message3: 8 Vector__XXX
 SG_ Signal3 : 0|8@1+ (0.001,-0.125) [0|0] "" Vector__XXX

SIG_VALTYPE_ 1024 Signal1 : 2;
SIG_VALTYPE_ 1025 Signal2 : 1;
SIG_VALTYPE_ 1025 Signal1 : 1;
