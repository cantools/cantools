VERSION ""

NS_ :

BS_:

BU_:

BO_ 1 msg1: 1 Vector__XXX
 SG_ signal1 : 0|8@1+ (1,0) [0|0] "" Vector__XXX

BO_ 2 msg2: 4 Vector__XXX
 SG_ signal2 : 0|32@1- (1,0) [0|0] "" Vector__XXX

VAL_ 1 signal1 3 "High" 2 "Standard" 1 "Low" 0 "Unknown" ;

SIG_VALTYPE_ 2 signal2 : 1;
