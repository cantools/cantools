VERSION ""

NS_ :

BS_:

BU_:

BO_ 1 msg1: 1 Vector__XXX
 SG_ signal1 : 0|8@1+ (1,0) [0|0] "" Vector__XXX

BO_ 2 msg2: 4 Vector__XXX
 SG_ signal2 : 0|32@1- (1,0) [0|0] "" Vector__XXX

SIG_VALTYPE_ 345 signal2 : 1;
