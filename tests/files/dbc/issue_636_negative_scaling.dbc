VERSION "1.0"

NS_ :

BS_:

BU_: PCM1 FOO
VAL_TABLE_ TempValueTable 4095 "Error" 4094 "Init" ;

BO_ 496 ExampleMessage: 2 PCM1
 SG_ Temperature : 3|12@0+ (-0.01,4100) [4070|4100] "degK"  PCM1,FOO

CM_ BO_ 496 "Example message";
BA_DEF_ SG_  "GenSigStartValue" INT -2147483648 2147483647;
BA_DEF_DEF_  "GenSigStartValue" 0;
BA_ "GenSigStartValue" SG_ 496 Temperature 4094;
VAL_ 496 Temperature 4095 "Error" 4094 "Init" ;
