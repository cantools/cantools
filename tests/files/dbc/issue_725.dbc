VERSION ""

NS_ :

BS_:

BU_: Node2 Node1

BO_ 1 TestMessage: 1 Node1
 SG_ Signal1 : 0|8@1+ (1,0) [0|250] ""  Node2

BA_DEF_  "BusType" STRING ;
BA_DEF_  "DBName" STRING ;
BA_DEF_ SG_  "GenSigStartValue" INT -2147483648 2147483647;
BA_DEF_DEF_  "BusType" "CAN";
BA_DEF_DEF_  "DBName" "";
BA_DEF_DEF_  "GenSigStartValue" -2147483648;
BA_ "DBName" "test";
BA_ "GenSigStartValue" SG_ 1 Signal1 254;
