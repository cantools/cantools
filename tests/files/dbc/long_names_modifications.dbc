VERSION ""

NS_ :

BS_:

BU_: NN_short

BO_ 1 MM_short: 8 NN_short
 SG_ SS_short : 0|8@1- (1,0) [0|0] "" Vector__XXX
