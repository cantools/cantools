VERSION ""

NS_ :

BS_:

BU_: FOO BAR FIE FUM

BO_ 1 Bar: 4 FOO
 SG_ Binary32 : 0|32@1- (1,0) [0|0] ""  FUM

BO_TX_BU_ 1 : FOO,BAR,FIE;
