VERSION ""

NS_ :

BS_:

BU_:

BO_ 472 Foo: 1 Vector__XXX
 SG_ signal_without_sender : 0|8@1- (1,0) [0|0] "" Vector__XXX

CM_ BO_ 472 "No sender message.";
