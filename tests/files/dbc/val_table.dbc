VERSION ""

NS_ :

BS_:

BU_:
VAL_TABLE_ Table3 16 "16" 7 "7" 2 "2" 0 "0" ;
VAL_TABLE_ Table2  ;
VAL_TABLE_ Table1 1 "One" 0 "Zero" ;

BO_ 0 Message1: 8 Vector__XXX
 SG_ Signal1 : 0|8@1- (1,0) [0|0] "" Vector__XXX

VAL_ 0 Signal1 1 "One" 0 "Zero" ;
