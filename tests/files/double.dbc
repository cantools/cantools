VERSION "HIPBNYYYYYYYYYYYYYYYYYYYYYYYYYYYYYYYYYYYYY/4/%%%/4/'%**4YYY///"

NS_ :

BS_:

BU_: TestNode

BO_ 1024 Message1: 8 TestNode
 SG_ Signal1 : 0|64@1- (1,0) [0|0] "" Vector__XXX

SIG_VALTYPE_ 1024 Signal1 : 2;
