VERSION "HIPBNYYYYYYYYYYYYYYYYYYYYYYYYYYYYYYYYYYYYY/4/%%%/4/'%**4YYY///"

NS_ :

BS_:

BU_: Node0

BO_ 1024 Message0: 8 Node0
 SG_ FooSignal : 0|2@1+ (1,0) [0|0] "" Vector__XXX
 SG_ BarSignal : 2|3@1+ (1,0) [0|0] "" Vector__XXX

VAL_ 1024 FooSignal 0 "FOO_A" 1 "FOO_B" 2 "FOO_C" 3 "FOO_D" ;
VAL_ 1024 BarSignal 0 "BAR_A" 1 "BAR_B" 2 "BAR_C" 3 "BAR_D" 4 "BAR_E" 5 "BAR_F" 6 "BAR_G" 7 "BAR_H" ;
