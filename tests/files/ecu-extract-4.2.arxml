AUTOSAR XML (schema 4-1-2)
package /MyEcu
  ecuc value collection MyEcu0: ecu-extract=SYSTEM, ecuc-values=[CanIf, Com]
  module config Com
    ComConfig ()
      3 x ComIPdu:
        Message1: ecuc-reference-value=Signal1, ecuc-reference-value=Signal5
        Message2: ecuc-reference-value=Signal2, ecuc-reference-value=Signal3, ecuc-reference-value=Signal4
        Message3
      5 x ComSignal:
        Signal1: ComBitPosition=4, ComBitSize=3, ComSignalEndianness=BIG_ENDIAN, ComSignalType=UINT8
        Signal2: ComBitPosition=18, ComBitSize=11, ComSignalEndianness=LITTLE_ENDIAN, ComSignalType=SINT16
        Signal3: ComBitPosition=6, ComBitSize=2, ComSignalEndianness=LITTLE_ENDIAN, ComSignalType=UINT8
        Signal4: ComBitPosition=30, ComBitSize=4, ComSignalEndianness=LITTLE_ENDIAN, ComSignalType=UINT8
        Signal5: ComBitPosition=16, ComBitSize=32, ComSignalEndianness=LITTLE_ENDIAN, ComSignalType=FLOAT32
