VERSION "2.0"

NS_ :

BU_: FOO BAR

BO_ 2147558193 Foo: 8 FOO
 SG_ Foo : 0|12@0- (0.01,250) [229.53|270.47] "degK" Vector__XXX, BAR
 SG_ Bar : 6|6@0+ (0.1,0) [1.0|5.0] "m" Vector__XXX, FOO

BO_ 2147558193 Fum: 8 FOO
 SG_ Fum : 0|12@0- (1,0) [0|1] "" Vector__XXX, BAR

CM_ BU_ BAR "fam";
CM_ BO_ 2147558193 "Foo.";

BA_ "FOO" BU_ FIE 1;
BA_ "BAR" BU_ FIE "FUM";

VAL_ 2147558193 Foo -1 "Foo" -2 "Fie" ;

VAL_TABLE_ State 0 "Disabled" 1 "Enabled" ;

BA_DEF_DEF_  "BusType" "CAN";
BA_ "GenMsgCycleTime" BO_ 2147558193 1;
