VERSION "2.0"

CM_ "File comment?";

NS_ :

BU_: FOO BAR FIE

BO_ 2147558193 Foo : 8 FOO
 SG_ Foo : 0|12@0- (0.01,250) [229.53|270.47] "degK" Vector__XXX, BAR
 SG_ Bar : 6|6@0+ (0.1,0) [1.0|5.0] "m" Vector__XXX, FOO

BO_ 2147558193 Fum: 5 FOO
 SG_ Fum : 0|12@1- (1,0) [0|1] "" Vector__XXX, BAR
 SG_ Fam : 12|12@1- (1.0,0.0) [0|1] "" Vector__XXX, BAR

BO_ 2147558194 Bar: 4 FOO
 SG_ Binary32 : 0|32@1- (1,0) [0|0] "" Vector__XXX, FUM

BO_ 2147558195 CanFd: 64 FOO
 SG_ Foo : 0|512@1- (1,0) [0|0] "" Vector__XXX, FUM

CM_ BU_ BAR "fam \"1\"";
CM_ BO_ 2147558193 "Foo.";

BA_ "FOO" BU_ FIE 1;
BA_ "BAR" BU_ FIE "FUM";

VAL_ 2147558193 Foo -1 "Foo" -2 "Fie" ;
VAL_ Bar 1 "Go" 0 "NoGo" ;

VAL_TABLE_ State 0 "Disabled" 1 "Enabled" ;

SIG_VALTYPE_ 2147558194 Binary32 : 1;

BA_DEF_DEF_  "BusType" "CAN";
BA_ "GenMsgCycleTime" BO_ 2147558193 1;

BA_DEF_ "AFloat" FLOAT 0.0 100.0;
BA_DEF_DEF_ "AFloat" 33.5;

BO_TX_BU_ 2147558194 : FOO,BAR;

BA_DEF_REL_ BU_SG_REL_ "GenSigTimeoutTime" INT 0 65535;
BA_DEF_DEF_REL_ "GenSigTimeoutTime" 0;
BA_REL_ "GenSigTimeoutTime" BU_SG_REL_ MFK_3 SG_ 780 ACC_02_CRC 999;

BA_DEF_REL_ BU_SG_REL_ "AFloat2" FLOAT 0.0 65535.0;
BA_DEF_DEF_REL_ "AFloat2" 0.0;
BA_REL_ "AFloat2" BU_SG_REL_ MFK_3 SG_ 780 ACC_02_CRC 999;
BA_REL_ "AFloat2" BU_SG_REL_ MFK_3 SG_ 780 ACC_02_CRC "";

SIG_GROUP_ 462 SecSomethingReq 1 : SomethingReqVal SomethingElseReqVal;
