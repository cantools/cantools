AUTOSAR XML (schema 00046)
package /Cluster
  can cluster Cluster0
    can physical channel Pch0
      frame Message1: id 0x5, frame-length=6, can-addressing-mode=STANDARD  # Comment1
        pdu message1: length=6
          signal signal1: start 4, 3 bit, big-endian, system signal Signal1, compu {phys=(0)/(2) for raw 0..4}
