VERSION ""

NS_ :

BS_:

BU_:

BO_ 256 SomeFrame: 8 Vector__XXX
 SG_ SomeDifferentSig : 0|8@1- (1,0) [0|0] "" Vector__XXX

BO_ 2620009002 SomeExtFrame: 8 Vector__XXX
 SG_ SomeSig : 0|8@1- (1,0) [0|0] "" Vector__XXX
