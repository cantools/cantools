VERSION ""

NS_ :

BS_:

BU_:

BO_ 256 MuxedFrame: 8 Vector__XXX
 SG_ UnmultiplexedSig : 16|8@1- (1,0) [0|0] "" Vector__XXX
 SG_ MultiplexedSig m42 : 8|8@1- (1,0) [0|0] "" Vector__XXX
 SG_ MultiplexorSig M : 0|8@1+ (1,0) [0|0] "" Vector__XXX
